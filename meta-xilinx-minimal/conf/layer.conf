## meta-xilinx-minimal/conf/layer.conf
```bitbake
# We have a conf and classes directory, add to BBPATH
BBPATH .= ":${LAYERDIR}"

# We have recipes-* directories, add to BBFILES
BBFILES += "${LAYERDIR}/recipes-*/*/*.bb \
            ${LAYERDIR}/recipes-*/*/*.bbappend"

BBFILE_COLLECTIONS += "meta-xilinx-minimal"
BBFILE_PATTERN_meta-xilinx-minimal = "^${LAYERDIR}/"
BBFILE_PRIORITY_meta-xilinx-minimal = "6"

LAYERDEPENDS_meta-xilinx-minimal = "core"
LAYERSERIES_COMPAT_meta-xilinx-minimal = "scarthgap"
```
